## sdkconfig.defaults
```kconfig
# Target configuration
CONFIG_IDF_TARGET="esp32s3"

# Flash size 16MB
CONFIG_ESPTOOLPY_FLASHSIZE_16MB=y

# Custom partition table (factory partition = 2MB for ESP-SR)
CONFIG_PARTITION_TABLE_CUSTOM=y
CONFIG_PARTITION_TABLE_CUSTOM_FILENAME="partitions.csv"

# Enable PSRAM
CONFIG_SPIRAM=y
CONFIG_SPIRAM_MODE_OCT=y
CONFIG_SPIRAM_SPEED_80M=y

# Disable Task Watchdog for IDLE tasks (audio streaming blocks CPU)
CONFIG_ESP_TASK_WDT_CHECK_IDLE_TASK_CPU0=n
CONFIG_ESP_TASK_WDT_CHECK_IDLE_TASK_CPU1=n

# Reduce LVGL log spam (only errors)
CONFIG_LOG_DEFAULT_LEVEL_INFO=y
CONFIG_LOG_MAXIMUM_LEVEL_INFO=y
CONFIG_LV_LOG_LEVEL_ERROR=y
```
